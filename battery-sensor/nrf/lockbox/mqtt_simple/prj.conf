## Kconfig
```
#
# Copyright (c) 2020 Nordic Semiconductor ASA
#
# SPDX-License-Identifier: LicenseRef-Nordic-5-Clause
#

menu "MQTT simple sample"
config MQTT_PUB_TOPIC
	string "MQTT publish topic"
	default "my/publish/topic"

config MQTT_SUB_TOPIC
	string "MQTT subscribe topic"
	default "my/subscribe/topic"

config MQTT_CLIENT_ID
	string "MQTT Client ID"
	help
	  Use a custom Client ID string. If not set, the client ID will be
	  generated based on IMEI number (for nRF9160 based targets) or
	  randomly (for other platforms).
	default ""

config MQTT_BROKER_HOSTNAME
	string "MQTT broker hostname"
	default "mqtt.eclipseprojects.io"

config MQTT_BROKER_PORT
	int "MQTT broker port"
	default 1883

config MQTT_MESSAGE_BUFFER_SIZE
	int "MQTT message buffer size"
	default 128

config MQTT_PAYLOAD_BUFFER_SIZE
	int "MQTT payload buffer size"
	default 128

config BUTTON_EVENT_PUBLISH_MSG
	string "The message to publish on a button event"
	default "Hello from nRF91 MQTT Simple Sample"

config BUTTON_EVENT_BTN_NUM
	int "The button number"
	default 1

config MQTT_RECONNECT_DELAY_S
	int "Seconds to delay before attempting to reconnect to the broker."
	default 60

config LTE_CONNECT_RETRY_DELAY_S
	int "Seconds to delay before attempting to retry LTE connection."
	default 120

config MQTT_TLS_SEC_TAG
	int "TLS credentials security tag"
	default 42

config MQTT_TLS_SESSION_CACHING
	bool "Enable TLS session caching"

config MQTT_TLS_PEER_VERIFY
	int "Set peer verification level"
	default 0
	help
		Set to 0 for VERIFY_NONE, 1 for VERIFY_OPTIONAL, and 2 for
		VERIFY_REQUIRED.

config MQTT_BROKER_USERNAME
	string "Set username"

config MQTT_BROKER_PASSWORD
	string "Set password"

config LOCKBOX_ID
	int "Lockbox ID"
	default 0

config APP_EVENT_MANAGER
	bool "Enable Event Manager"
	default y

config NFC_TAG_ID
	string "NFC tag ID"

endmenu

menu "Zephyr Kernel"
source "Kconfig.zephyr"
endmenu

module = MQTT_SIMPLE
module-str = MQTT Simple
source "${ZEPHYR_BASE}/subsys/logging/Kconfig.template.log_config"
```

## prj.conf
```kconfig
#
# Copyright (c) 2020 Nordic Semiconductor ASA
#
# SPDX-License-Identifier: LicenseRef-Nordic-5-Clause
#

#Enable modem trace collection
#CONFIG_NRF_MODEM_LIB_TRACE=y

#Enable AT-commands
#CONFIG_UART_INTERRUPT_DRIVEN=y
#CONFIG_AT_HOST_LIBRARY=y

# Networking
CONFIG_NETWORKING=y
CONFIG_NET_NATIVE=n
CONFIG_NET_SOCKETS_OFFLOAD=y
CONFIG_NET_SOCKETS=y
CONFIG_NET_SOCKETS_POSIX_NAMES=y

# LTE link control
CONFIG_LTE_LINK_CONTROL=y
CONFIG_LTE_AUTO_INIT_AND_CONNECT=n

# Modem library
CONFIG_NRF_MODEM_LIB=y

## Modem key management, for provisioning certificates
CONFIG_MODEM_KEY_MGMT=y

# MQTT
CONFIG_MQTT_LIB=y
CONFIG_MQTT_LIB_TLS=y
CONFIG_MQTT_CLEAN_SESSION=y
CONFIG_MQTT_TLS_SEC_TAG=42
CONFIG_MQTT_TLS_PEER_VERIFY=2

## Application
CONFIG_MQTT_PUB_TOPIC="nrf/info"
CONFIG_MQTT_SUB_TOPIC="nrf/command"
CONFIG_MQTT_CLIENT_ID="nrf-elfryd"
CONFIG_MQTT_BROKER_HOSTNAME="kystlaget-mqtt.westeurope.cloudapp.azure.com"
CONFIG_MQTT_BROKER_PORT=8885
CONFIG_MQTT_BROKER_USERNAME="lockboxclient"
CONFIG_MQTT_BROKER_PASSWORD="1tcb7*50aFYIuG7u"
CONFIG_LOCKBOX_ID=1

## Button support
CONFIG_DK_LIBRARY=y

## Enable logging
CONFIG_LOG=y
CONFIG_MQTT_SIMPLE_LOG_LEVEL_DBG=y

## Memory
CONFIG_MAIN_STACK_SIZE=4096
CONFIG_HEAP_MEM_POOL_SIZE=2048

# NewLib C
CONFIG_NEWLIB_LIBC=y


#For NFC
CONFIG_NCS_SAMPLES_DEFAULTS=y

CONFIG_SPI=y

CONFIG_ST25R3911B_LIB=y

CONFIG_NFC_NDEF=y
CONFIG_NFC_NDEF_RECORD=y
CONFIG_NFC_NDEF_MSG=y
CONFIG_NFC_NDEF_PARSER=y
CONFIG_NFC_NDEF_LE_OOB_REC_PARSER=y
CONFIG_NFC_T2T_PARSER=y
CONFIG_NFC_T4T_HL_PROCEDURE=y
CONFIG_NFC_NDEF_CH_PARSER=y

CONFIG_POLL=y

CONFIG_ST25R3911B_LIB_LOG_LEVEL_DBG=y
CONFIG_LOG=y
CONFIG_LOG_OUTPUT=y


CONFIG_APP_EVENT_MANAGER=y

CONFIG_NFC_TAG_ID="048855F2CB7280"
```

## src/nfc_event.c
```c
#include "nfc_event.h"

static void log_nfc_event(const struct app_event_header *aeh)
{
    const struct nfc_event *event = cast_nfc_event(aeh);

    APP_EVENT_MANAGER_LOG(aeh, "New NFC event, tag is_present=%d\n", event->is_present);
}

APP_EVENT_TYPE_DEFINE(
    nfc_event,
    log_nfc_event,
    NULL,
    APP_EVENT_FLAGS_CREATE(APP_EVENT_TYPE_FLAGS_INIT_LOG_ENABLE));

void create_submit_nfc_event(bool is_present)
{
    struct nfc_event *event = new_nfc_event();

    event->is_present = is_present;

    APP_EVENT_SUBMIT(event);
}
```

## src/nfc_helpers.h
```c
#include <zephyr/types.h>
#include <stddef.h>
#include <stdbool.h>
#include <zephyr/kernel.h>
#include <zephyr/sys/printk.h>
#include <st25r3911b_nfca.h>
#include <nfc/ndef/msg_parser.h>
#include <nfc/ndef/le_oob_rec_parser.h>
#include <nfc/t2t/parser.h>
#include <nfc/t4t/ndef_file.h>
#include <nfc/t4t/isodep.h>
#include <nfc/t4t/hl_procedure.h>
#include <nfc/ndef/ch_rec_parser.h>
#include <zephyr/sys/byteorder.h>
#include <stdio.h>

// Variable that holds current key status
extern bool key_present_state;

#define NFCA_BD 128
#define BITS_IN_BYTE 8
#define MAX_TLV_BLOCKS 10
#define MAX_NDEF_RECORDS 10
#define NFCA_T2T_BUFFER_SIZE 1024
#define NFCA_LAST_BIT_MASK 0x80
#define NFCA_FDT_ALIGN_84 84
#define NFCA_FDT_ALIGN_20 20

#define NFC_T2T_READ_CMD 0x30
#define NFC_T2T_READ_CMD_LEN 0x02

#define NFC_T4T_ISODEP_FSD 256
#define NFC_T4T_ISODEP_RX_DATA_MAX_SIZE 1024
#define NFC_T4T_APDU_MAX_SIZE 1024

#define NFC_NDEF_REC_PARSER_BUFF_SIZE 128

#define NFC_TX_DATA_LEN NFC_T4T_ISODEP_FSD
#define NFC_RX_DATA_LEN NFC_T4T_ISODEP_FSD

#define T2T_MAX_DATA_EXCHANGE 16
#define TAG_TYPE_2_DATA_AREA_MULTIPLICATOR 8
#define TAG_TYPE_2_DATA_AREA_SIZE_OFFSET (NFC_T2T_CC_BLOCK_OFFSET + 2)
#define TAG_TYPE_2_BLOCKS_PER_EXCHANGE (T2T_MAX_DATA_EXCHANGE / NFC_T2T_BLOCK_SIZE)

#define TRANSMIT_DELAY 3000
#define ALL_REQ_DELAY 2000

extern uint8_t tx_data[NFC_TX_DATA_LEN];
extern uint8_t rx_data[NFC_RX_DATA_LEN];

extern struct k_poll_event events[ST25R3911B_NFCA_EVENT_CNT];
extern struct k_work_delayable transmit_work;

extern struct st25r3911b_nfca_buf nfc_tx_buf;
extern const struct st25r3911b_nfca_buf nfc_rx_buf;

enum nfc_tag_type
{
    NFC_TAG_TYPE_UNSUPPORTED = 0,
    NFC_TAG_TYPE_T2T,
    NFC_TAG_TYPE_T4T
};

enum t2t_state
{
    T2T_IDLE,
    T2T_HEADER_READ,
    T2T_DATA_READ
};

struct t2t_tag
{
    enum t2t_state state;
    uint16_t data_bytes;
    uint8_t data[NFCA_T2T_BUFFER_SIZE];
};

struct t4t_tag
{
    uint8_t data[NFC_T4T_ISODEP_RX_DATA_MAX_SIZE];
    uint8_t ndef[MAX_TLV_BLOCKS][NFC_T4T_APDU_MAX_SIZE];
    uint8_t tlv_index;
};

struct key_status
{
    bool current_state;
    bool previous_state
};

extern enum nfc_tag_type tag_type;
extern struct t2t_tag t2t;
extern struct t4t_tag t4t;

extern const struct st25r3911b_nfca_cb cb;
extern const struct nfc_t4t_isodep_cb t4t_isodep_cb;
extern const struct nfc_t4t_hl_procedure_cb t4t_hl_procedure_cb;

void nfc_tag_detect(bool all_request);

int ftd_calculate(uint8_t *data, size_t len);

int nfc_t2t_read_block_cmd_make(uint8_t *tx_data, size_t tx_data_size, uint8_t block_num);

int t2t_header_read(void);

void ndef_le_oob_rec_analyze(const struct nfc_ndef_record_desc *le_oob_rec_desc);

void ndef_rec_analyze(const struct nfc_ndef_record_desc *ndef_rec_desc);

void ndef_data_analyze(const uint8_t *ndef_msg_buff, size_t nfc_data_len);

void t2t_data_read_complete(uint8_t *data);

int t2t_on_data_read(const uint8_t *data, size_t data_len, void (*t2t_read_complete)(uint8_t *));

int on_t2t_transfer_complete(const uint8_t *data, size_t len);

void transfer_handler(struct k_work *work);

void nfc_field_on(void);

void nfc_timeout(bool tag_sleep);

void nfc_field_off(void);

void tag_detected(const struct st25r3911b_nfca_sens_resp *sens_resp);

void anticollision_completed(const struct st25r3911b_nfca_tag_info *tag_info, int err);

void transfer_completed(const uint8_t *data, size_t len, int err);

void tag_sleep(void);

void t4t_isodep_selected(const struct nfc_t4t_isodep_tag *t4t_tag);

void t4t_isodep_error(int err);

void t4t_isodep_data_send(uint8_t *data, size_t data_len, uint32_t ftd);

void t4t_isodep_received(const uint8_t *data, size_t data_len);

void t4t_isodep_deselected(void);

void t4t_hl_selected(enum nfc_t4t_hl_procedure_select type);

void t4t_hl_cc_read(struct nfc_t4t_cc_file *cc);

void t4t_hl_ndef_read(uint16_t file_id, const uint8_t *data, size_t len);

void delay(uint32_t delay);

int setup_nfc(void);
```

## src/publish_event.c
```c
#include "publish_event.h"
#include "mqtt_helpers.h"
#include "lock_detect_event.h"
#include "nfc_event.h"
#include <stdio.h>

static void log_publish_event(const struct app_event_header *aeh)
{
    const struct publish_event *event = cast_publish_event(aeh);

    APP_EVENT_MANAGER_LOG(aeh, "data=%s", event->data);
}

static bool event_handler(const struct app_event_header *aeh)
{
    
    if (is_lock_detect_event(aeh))
    {
        const struct lock_detect_event *event = cast_lock_detect_event(aeh);

        char data[50];
        sprintf(data, "%d?LOCK_EVENT=%d", CONFIG_LOCKBOX_ID,event->is_pressed);
        printk("Lock event received: %d\n", event->is_pressed);

        int ret = data_publish(
            &client,
            MQTT_QOS_1_AT_LEAST_ONCE,
            data,
            strlen(data));
        
        if (ret == 0)
        {
            printk("Publishing data succeeded");
        }
        else
        {
            printk("Publishing data failed");
        }
        return true;
    }


    if (is_nfc_event(aeh))
    {
        const struct nfc_event *event = cast_nfc_event(aeh);

        char data[50];
        sprintf(data, "%d?KEY_EVENT=%d", CONFIG_LOCKBOX_ID,event->is_present);
        printk("NFC event received: %d\n", event->is_present);
        int ret = data_publish(
            &client,
            MQTT_QOS_1_AT_LEAST_ONCE,
            data,
            strlen(data));

        if (ret == 0)
        {
            printk("Publishing data succeeded");
        }
        else
        {
            printk("Publishing data failed");
        }

        return true;
    }
    return true;
}


APP_EVENT_TYPE_DEFINE(
    publish_event,
    log_publish_event,
    NULL,
    APP_EVENT_FLAGS_CREATE(APP_EVENT_TYPE_FLAGS_INIT_LOG_ENABLE));

APP_EVENT_LISTENER(publish_event, event_handler);
APP_EVENT_SUBSCRIBE(publish_event, nfc_event);
APP_EVENT_SUBSCRIBE(publish_event, lock_detect_event);
```
