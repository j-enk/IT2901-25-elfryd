## CMakeLists.txt
```
# SPDX-License-Identifier: Apache-2.0

cmake_minimum_required(VERSION 3.20.0)

find_package(Zephyr REQUIRED HINTS $ENV{ZEPHYR_BASE})
project(kystlaget_peripheral)

FILE(GLOB app_sources src/*.c)
FILE(GLOB app_headers include/*.h)
# Conditionally include sensor source
if(NOT CONFIG_USE_SENSOR_ADC)
  list(REMOVE_ITEM app_sources ${CMAKE_CURRENT_SOURCE_DIR}/src/sensor_adc.c)
elseif(NOT CONFIG_USE_SENSOR_BME)
  list(REMOVE_ITEM app_sources ${CMAKE_CURRENT_SOURCE_DIR}/src/sensor_bme.c)
elseif(NOT CONFIG_USE_SENSOR_MPU)
  list(REMOVE_ITEM app_sources ${CMAKE_CURRENT_SOURCE_DIR}/src/sensor_mpu.c)
endif()

target_sources(app PRIVATE
  ${app_sources}
  )
```

## Kconfig
```
config BATTERY_ID
	int "The id of the battery"
	default 0

choice 
	prompt "Sensor to use"

config USE_ADC
	bool "Use ADC for battery measurement"
	default n
	help
	  Enable this option to use the ADC for measuring battery voltage.

config USE_BME280
    bool "Use BME280 Sensor"
	default n
    help
      Select this to use the BME280 sensor.

config USE_MPU6050
    bool "Use MPU6050 Sensor"
	default n
    help
      Select this to use the MPU6050 sensor.

endchoice
```

## Kconfig.sysbuild
```
# Copyright 2023-2024 Nordic Semiconductor ASA
# SPDX-License-Identifier: Apache-2.0

# Er denne nødvendig?
source "share/sysbuild/Kconfig"

config NET_CORE_BOARD
	string
	default "nrf5340dk/nrf5340/cpunet" if $(BOARD) = "nrf5340dk"
	default "nrf5340_audio_dk/nrf5340/cpunet" if $(BOARD) = "nrf5340_audio_dk"
	default "nrf5340bsim/nrf5340/cpunet" if $(BOARD_TARGET_STRING) = "NRF5340BSIM_NRF5340_CPUAPP"

config NET_CORE_IMAGE_HCI_IPC
	bool "HCI IPC image on network core"
	default y
	depends on NET_CORE_BOARD != ""
```

## prj.conf
```kconfig
CONFIG_BT=y
CONFIG_LOG=y

CONFIG_BT_PERIPHERAL=y

CONFIG_BT_DEVICE_NAME="Kystlaget Peripheral"
CONFIG_BT_DEVICE_APPEARANCE=833
CONFIG_ADC=y

# temperature
CONFIG_GPIO=y
CONFIG_I2C=y
CONFIG_SENSOR=y
CONFIG_BME280=y
CONFIG_CBPRINTF_FP_SUPPORT=y

# mpu
CONFIG_MPU6050_TRIGGER_NONE=y
```

## boards/promicro_nrf52840_nrf52840_uf2.overlay
```dts
#if defined(CONFIG_USE_ADC)
/ {
    zephyr,user {
        io-channels = <&adc 0>;
    };
};
&adc {
    #address-cells = <1>;
    #size-cells = <0>;
    status = "okay";
    channel@0 {
        reg = <0>;
        zephyr,gain = "ADC_GAIN_1_6";
        zephyr,reference = "ADC_REF_INTERNAL";
        zephyr,acquisition-time = <ADC_ACQ_TIME_DEFAULT>;

        zephyr,input-positive = <NRF_SAADC_AIN0>; /* P0.02 for nRF52xx, P0.04 for nRF5340 */
        // for testing, 3.3V:
        // zephyr,input-positive = <NRF_SAADC_VDD>;

        zephyr,resolution = <12>;
    };
};
#elif defined(CONFIG_USE_BME280)
&i2c0 {
    bme280@76 {
        compatible = "bosch,bme280";
        reg = <0x76>;
        status = "okay";
    };
};
#elif defined(CONFIG_USE_MPU6050)
&i2c0 {
    mpu6050@68 {
        compatible = "invensense,mpu6050";
        reg = <0x68>;
        status = "okay";
        int-gpios = <&gpio0 11 GPIO_ACTIVE_HIGH>;
    };
};
#endif
```

## src/main.c
```c
#include <zephyr/kernel.h>
#include "sensor.h"
#include "ble.h"
#include "led.h"

int main(void){
    int err;

    // Initialize Bluetooth
    err = ble_init();
    if (err){
        printk("Bluetooth initialization failed (err %d)\n", err);
        return err;
    }

    // Initialize LED
    init_led();
    err = led_init();
    if (err) {
        printk("LED initialization failed (err %d)\n", err);
        return err;
    }

    // Start LED blinking
    led_set_connection_state(false);

    // Initialize sensors
    err = sensor_init();
    if (err) {
        printk("Sensor initialization failed (err %d)\n", err);
        return err;
    }

    err = ble_advertise();
    if (err) {
        printk("Advertising failed (err %d)\n", err);
        return err;
    }
    k_sleep(K_FOREVER);
    return 0;
}
```

## src/adc.c
```c
#include "adc.h"
#include <zephyr/drivers/adc.h>
#include <zephyr/kernel.h>

static const struct adc_dt_spec adc_channel = ADC_DT_SPEC_GET(DT_PATH(zephyr_user));

int baut_adc_init(void) {
    if (!adc_is_ready_dt(&adc_channel)) {
        printk("ADC controller device %s not ready\n", adc_channel.dev->name);
        return -1;
    }

    int err = adc_channel_setup_dt(&adc_channel);
    if (err) {
        printk("Could not setup channel #%d (%d)\n", 0, err);
        return err;
    }

    return 0;
}

int baut_adc_read(int32_t *mv) {
    int16_t buf;
    struct adc_sequence sequence = {
        .buffer = &buf,
        .buffer_size = sizeof(buf),
    };
    int err = adc_sequence_init_dt(&adc_channel, &sequence);
    if (err) {
        printk("Could not initialize sequence\n");
        return -1;
    }

    err = adc_read(adc_channel.dev, &sequence);
    if (err) {
        printk("Could not read (%d)\n", err);
        return -1;
    }

    int32_t val_mv = buf;
    err = adc_raw_to_millivolts_dt(&adc_channel, &val_mv);
    if (err) {
        printk("adc_raw_to_millivolts_dt failed: %d\n", err);
        return -1;
    }

    val_mv *= 6.23;
    *mv = val_mv;
    return 0;
}
```

## src/adc.h
```c
#ifndef ADC_H
#define ADC_H

#include <stdint.h>

int baut_adc_init(void);
int baut_adc_read(int32_t *mv);

#endif // ADC_H
```

## src/ble.c
```c
#include <zephyr/kernel.h>
#include <zephyr/bluetooth/bluetooth.h>
#include <zephyr/bluetooth/conn.h>
#include <zephyr/bluetooth/gatt.h>

#include "ble.h"
#include "led.h"
#include "sensors/uuid.h"

int ble_init(void)
{
    int err;

    // Initialize Bluetooth stack
    err = bt_enable(NULL);
    if (err) {
        return err;
    }
}

/*
-----------------------------------------------------------------------------
                    ADVERTISING AND CONNECTION HANDLING
-----------------------------------------------------------------------------
*/

static const struct bt_data ad[] = {
    BT_DATA_BYTES(BT_DATA_FLAGS, (BT_LE_AD_GENERAL | BT_LE_AD_NO_BREDR)),
    BT_DATA(BT_DATA_UUID128_ALL, custom_uuid, sizeof(custom_uuid)),
};

static const struct bt_data sd[] = {
    BT_DATA(BT_DATA_NAME_COMPLETE, CONFIG_BT_DEVICE_NAME, sizeof(CONFIG_BT_DEVICE_NAME) - 1),
};

int ble_advertise(){
    int err;

    err = bt_le_adv_start(BT_LE_ADV_CONN_FAST_1, ad, ARRAY_SIZE(ad), sd, ARRAY_SIZE(sd));
    if (err) {
        return err;
    }
}

static void connected(struct bt_conn *conn, uint8_t err)
{
    if (err) {
        printk("Connection failed, err 0x%02x %s\n", err, bt_hci_err_to_str(err));
    } else {
        led_set_connection_state(true);
    }
}

static void disconnected(struct bt_conn *conn, uint8_t reason)
{
    led_set_connection_state(false);
    ble_advertise();
}

BT_CONN_CB_DEFINE(conn_callbacks) = {
    .connected = connected,
    .disconnected = disconnected,
};

/*
-----------------------------------------------------------------------------
                               GATT Service
-----------------------------------------------------------------------------
*/

static ssize_t id_read_function(struct bt_conn *conn, const struct bt_gatt_attr *attr, void *buf,
    uint16_t len, uint16_t offset)
{
uint8_t sensor_id = CONFIG_BATTERY_ID;

return bt_gatt_attr_read(conn, attr, buf, len, offset, &sensor_id, sizeof(sensor_id));
}

BT_GATT_SERVICE_DEFINE(id_srvc,
    BT_GATT_PRIMARY_SERVICE(BT_UUID_ID),
    BT_GATT_CHARACTERISTIC(BT_UUID_ID, BT_GATT_CHRC_READ, BT_GATT_PERM_READ,
                   id_read_function, NULL, NULL),
);
```

## src/ble.h
```c
#ifdef BLE_H
#define BLE_H

int ble_init(void);

int ble_advertise(void);

#endif // BLE_H
```

## src/bluetooth.c
```c
#include "bluetooth.h"
#include <zephyr/bluetooth/bluetooth.h>
#include <zephyr/bluetooth/hci.h>
#include <zephyr/bluetooth/conn.h>
#include <zephyr/bluetooth/uuid.h>
#include <zephyr/bluetooth/gatt.h>
#include <zephyr/kernel.h>

static ATOMIC_DEFINE(state, 2U);

#define STATE_CONNECTED    1U
#define STATE_DISCONNECTED 2U

static void connected(struct bt_conn *conn, uint8_t err) {
    if (err) {
        printk("Connection failed, err 0x%02x %s\n", err, bt_hci_err_to_str(err));
    } else {
        printk("Connected!!!\n");
        (void)atomic_set_bit(state, STATE_CONNECTED);
    }
}

static void disconnected(struct bt_conn *conn, uint8_t reason) {
    printk("Disconnected, reason 0x%02x %s\n", reason, bt_hci_err_to_str(reason));
    (void)atomic_set_bit(state, STATE_DISCONNECTED);
}

BT_CONN_CB_DEFINE(conn_callbacks) = {
    .connected = connected,
    .disconnected = disconnected,
};

void bluetooth_init(void) {
    int err = bt_enable(NULL);
    if (err) {
        printk("Bluetooth init failed (err %d)\n", err);
        return;
    }
    printk("Bluetooth initialized\n");
}
```

## src/bluetooth.h
```c
#ifndef BLUETOOTH_H
#define BLUETOOTH_H

void bluetooth_init(void);

#endif // BLUETOOTH_H
```

## src/bme280.c
```c
#include "bme280.h"
#include <zephyr/device.h>
#include <zephyr/drivers/sensor.h>
#include <zephyr/kernel.h>

const struct device *bme280_dev = DEVICE_DT_GET_ANY(bosch_bme280);
static struct sensor_value temperature;

int baut_bme_init(void) {
    if (bme280_dev == NULL) {
        printk("BME is missing!\n");
        return -1;
    }

    if (!device_is_ready(bme280_dev)) {
        printk("BME is not ready\n");
        return -1;
    }

    return 0;
}

int baut_bme_read(int32_t *celcius) {
    int succeeded = false;

    for (int i = 0; i < 10; i++) {
        int err = sensor_sample_fetch(bme280_dev);
        if (err) {
            if (err != -EAGAIN) {
                printk("BME sample fail: %d\n", err);
            }
            continue;
        }

        err = sensor_channel_get(bme280_dev, SENSOR_CHAN_AMBIENT_TEMP, &temperature);
        if (err) {
            printk("BME channel fail: %d\n", err);
            continue;
        }

        succeeded = true;
        break;
    }

    if (succeeded) {
        *celcius = temperature.val1;
    }

    return succeeded ? 0 : -1;
}
```

## src/bme280.h
```c
#ifndef BME280_H
#define BME280_H

#include <stdint.h>

int baut_bme_init(void);
int baut_bme_read(int32_t *celcius);

#endif // BME280_H
```

## src/led.c
```c
#include <zephyr/kernel.h>
#include <zephyr/devicetree.h>
#include <zephyr/drivers/gpio.h>

#include "led.h"

ATOMIC_DEFINTE(state, 2U);

#define STATE_CONNECTED    1U
#define STATE_DISCONNECTED 2U
#define BLINK_TIMER K_MSEC(500)
#define LED0_NODE DT_ALIAS(led0)

static const struct gpio_dt_spec led = GPIO_DT_SPEC_GET(LED0_NODE, gpios);
static struct k_work_delayable blink_work;
static bool led_is_on;

static void blink_handler(struct k_work *work){
    led_is_on = !led_is_on;
    gpio_pin_set(led.port, led.pin, (int)led_is_on);
    k_work_schedule(&blink_work, BLINK_TIMER);
}

void init_led(void){
    int err;

    if(!gpio_is_ready_dt(&led)){
        printk("LED device not ready\n");
        return -EIO;
    }
    err = gpio_pin_configure_dt(&led, GPIO_OUTPUT_ACTIVE);
    if(err){
        printk("Could not configure GPIO pin %d (%d)\n", led.pin, err);
        return -EIO;
    }
    k_work_init_delayable(&blink_work, blink_handler);
}

void led_set_connection_state(bool state){
    if(state == true){
        (void)atomic_set_bit(state, STATE_CONNECTED);
        k_work_cancel_delayable(&blink_work);
    }
    else if (state == false) {
        (void)atomic_set_bit(state, STATE_DISCONNECTED);
        k_work_schedule(&blink_work, BLINK_TIMER);
    }
    else
    {
        /* Error */
    }   
}
```

## src/led.h
```c
#ifdef LED_H
#define LED_H

void led_init(void);

void led_set_connection_state(bool state);

#endif // LED_H
```

## src/mpu6050.c
```c
#include "mpu6050.h"
#include <zephyr/device.h>
#include <zephyr/drivers/sensor.h>
#include <zephyr/kernel.h>

const struct device *const mpu6050 = DEVICE_DT_GET_ONE(invensense_mpu6050);

int baut_mpu_init(void) {
    if (mpu6050 == NULL) {
        printk("MPU is missing!\n");
        return -1;
    }

    if (!device_is_ready(mpu6050)) {
        printk("MPU is not ready\n");
        return -1;
    }

    return 0;
}

int baut_mpu_read(double values[6]) {
    struct sensor_value accel[3];
    struct sensor_value gyro[3];

    int err = sensor_sample_fetch(mpu6050);
    if (err) {
        printk("MPU6050: sample fetch failed: %d\n", err);
        return err;
    }

    err = sensor_channel_get(mpu6050, SENSOR_CHAN_ACCEL_XYZ, accel);
    if (err) {
        printk("MPU6050: accel failed: %d\n", err);
        return err;
    }

    err = sensor_channel_get(mpu6050, SENSOR_CHAN_GYRO_XYZ, gyro);
    if (err) {
        printk("MPU6050: gyro failed: %d\n", err);
        return err;
    }

    values[0] = sensor_value_to_double(&accel[0]);
    values[1] = sensor_value_to_double(&accel[1]);
    values[2] = sensor_value_to_double(&accel[2]);
    values[3] = sensor_value_to_double(&gyro[0]);
    values[4] = sensor_value_to_double(&gyro[1]);
    values[5] = sensor_value_to_double(&gyro[2]);

    return 0;
}
```

## src/mpu6050.h
```c
#ifndef MPU6050_H
#define MPU6050_H

#include <stdint.h>

int baut_mpu_init(void);
int baut_mpu_read(double values[6]);

#endif // MPU6050_H
```
