## battery-sensor/bluetooth/Peripheral/build/Kconfig/boards/Kconfig.sysbuild
```kconfig
# Load Sysbuild board Kconfig descriptions.
osource "C:/ncs/v2.9.0/zephyr/boards/nordic/nrf51dk/Kconfig.sysbuild"
```

## battery-sensor/bluetooth/Peripheral/build/Peripheral/Kconfig/Kconfig.shield.defconfig
```kconfig
osource "C:/Users/david/ZephyrProjects/bt-fund/v2.9.0-v2.7.0/l3/Peripheral/boards/shields/*/Kconfig.defconfig"
osource "C:/ncs/v2.9.0/nrf/boards/shields/*/Kconfig.defconfig"
```

## battery-sensor/nrf/mqtt_simple/sample.yaml
```yaml
sample:
  description: NFC Tag Reader sample
  name: NFC Tag Reader
tests:
  sample.nfc.tag_reader:
    build_only: true
    integration_platforms:
      - nrf52840dk_nrf52840
      - nrf52dk_nrf52832
      - nrf5340dk_nrf5340_cpuapp
      - nrf9160dk_nrf9160
    platform_allow: nrf52840dk_nrf52840 nrf52dk_nrf52832 nrf5340dk_nrf5340_cpuapp nrf9160dk_nrf9160
    tags: ci_build
```
