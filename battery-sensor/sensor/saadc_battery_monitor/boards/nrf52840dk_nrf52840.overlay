/ {
    zephyr,user {
        /* Define one ADC channel for voltage input */
        io-channels = <&adc 0>;
    };
};

&adc {
    #address-cells = <1>;
    #size-cells = <0>;

    channel@0 {
        reg = <0>;
        zephyr,gain = "ADC_GAIN_1_6";
        zephyr,reference = "ADC_REF_INTERNAL";
        zephyr,acquisition-time = <ADC_ACQ_TIME_DEFAULT>;
        zephyr,input-positive = <NRF_SAADC_AIN1>; /* P0.03 (A0) */
        zephyr,resolution = <12>;
    };
};